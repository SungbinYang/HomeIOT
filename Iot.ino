
#include <DHT.h>
#include <Wire.h>
#include <SPI.h>
#include <Ethernet.h>
#include <NewTone.h>
#include <IRremote.h>
#include <OzOLED.h>

#define DHTTYPE DHT11   // DHTTYPE을 DHT11로 설정
#define RECV_PIN A1     // 아날로그 핀 1번에 적외선 감지 센서 연결
#define DHTPIN A2       // 아날로그 핀 2번에 온습도 센서를  연결

#define Buzzerpin 3     // 디지털 핀 3번에 부저의 +를 연결
#define Relaypin 4      // 디지털 핀 4번에 릴레이 모듈의 S 핀을 연결
#define GASpin 5        // 디지털 핀 5번에 가스 감지 센서의 DO 핀을 연결
#define redPin 7        // 디지털 핀 7번에 RGB_LED 모듈의 RED 핀을 연결
#define greenPin 8      // 디지털 핀 8번에 RGB_GREEN 모듈의 GREEN 핀을 연결
#define bluePin 9       // 디지털 핀 9번에 RGB_BLUE 모듈의 BLUE 핀을 연결
#define windowPin 10    // 디지털 핀 10번에 창문 모듈의 BLUE 핀을 연결

String line;                     //line 변수 선언
boolean Ethernet_Relay = false;  //릴레이 초기값 OFF
boolean CNT = false;             //CNT 초기화
int length = 0;                  //length 초기화
boolean State_Relay;             //Relay 상태 변수 선언


// "가스감지" 비트맵 배열
const static unsigned char Gas_Leak[] PROGMEM = {
  0xFF, 0xFF, 0xFF, 0xFF, 0xFF, 0xFF, 0xFF, 0xFF, 0xFF, 0xFF, 0xFF, 0xFF, 0xFF, 0xFF, 0xFF, 0xFF,
  0xFF, 0xFF, 0xFF, 0xFF, 0xFF, 0xFF, 0xFF, 0xFF, 0xFF, 0xFF, 0xFF, 0xFF, 0xFF, 0xFF, 0xFF, 0xFF,
  0xFF, 0xFF, 0xFF, 0xFF, 0xFF, 0xFF, 0xFF, 0xFF, 0xFF, 0xFF, 0xFF, 0xFF, 0xFF, 0xFF, 0xFF, 0xFF,
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  0xFF, 0xFF, 0xFF, 0xFF, 0xFF, 0xFF, 0xFF, 0xFF, 0xFF, 0xFF, 0xFF, 0xFF, 0xFF, 0xFF, 0xFF, 0xFF
};



DHT dht(DHTPIN, DHTTYPE); // 온습도 센서 DHT 설정
IRrecv irrecv(RECV_PIN);  //IR리시버 선언
decode_results results;

byte mac[] = {0x74, 0x69, 0x69, 0x2D, 0x30, 0x5};

//사용할 IP 주소 설정
IPAddress ip(10, 11, 51, 116);   

//사용할 포트 입력
EthernetServer server(80);

void client();  //클라이언트 선언

void setup()
{
  // 각각의 연결 핀들의 입출력을 설정
  pinMode(DHTPIN, INPUT);      //온습도센서
  pinMode(GASpin, INPUT);      //가스감지센서
  pinMode(Buzzerpin, OUTPUT);  //부저
  pinMode(Relaypin, OUTPUT);   //릴레이 모듈
  pinMode(redPin, OUTPUT);     //RGB LED red
  pinMode(greenPin, OUTPUT);   //RGB LED green
  pinMode(bluePin, OUTPUT);    //RGB LED blue
  irrecv.enableIRIn();         //IR리시버
  SPI.begin();                 //네트워크 통신 시작

  State_Relay = LOW; // 릴레이 모듈 초기 값 OFF
  //OLED의 초기 값
  OzOled.init();
  OzOled.printString("--------------------", 0, 0);
  OzOled.printString("Hello", 3, 2);
  OzOled.printString("Detecting...", 2, 4);
  OzOled.printString("--------------------", 0, 6);
  

  Serial.begin(9600);  //시리얼 모터의 속도를 9600으로 맞춤

  // 이더넷 서버 연결 시작
  Ethernet.begin(mac, ip);
  server.begin();
  Serial.print("server is at ");
  Serial.println(Ethernet.localIP());
  line.reserve(200);

  // 아두이노 초기화시 LED 및 부저 작동
  setColor(255, 0, 0);      //red
  NewTone(Buzzerpin, 261);  //부저 261
  delay(100);
  
  setColor(0, 255, 0);      //green
  NewTone(Buzzerpin, 330);  //부저 261
  delay(100);
  
  setColor(0, 0, 255);      //blue
  NewTone(Buzzerpin, 392);  //부저 261
  delay(100);
  
  setColor(255, 0, 255);    //crimson
  NewTone(Buzzerpin, 523);  //부저 261
  delay(100);
  
  setColor(0, 0, 0);        //LED OFF
  delay(100);
  noNewTone(Buzzerpin);     //부저 OFF
}

void loop()
{
  int GasVal = digitalRead(GASpin);  //가스값 읽고 GasVal에 값 전달

  EthernetClient client = server.available(); //이더넷 서버를 이용 가능한지 확인

  if (client)  //서버가 열리면
  {
    Serial.println("new client");      //시리얼 모니터 new client 출력
    boolean currentLineIsBlank = true; //현재 line이 비어있는지 확인하는 값 선언과 초기화
    line = "";                         //line 초기값

    while (client.connected())         //클라이언트와 연결되어 있으면 True 반복한다.
    {
      if (client.available())          //클라이언트로부터 수신된 데이터의 길이를 반환 없으면 0
      {
        char c = client.read();        //클라이언트로부터 수신된 데이터를 한바이트 읽는다.
        line += c;                     //c에서 1을 더해서 line에 넣는다.
        Serial.write(c);               //시리얼모니터에 데이터를 쓴다

        if (c == '\n' && currentLineIsBlank)   
        {
          Serial.println();                
          if (CNT)                         
          {
            line = "";                     

            for (int i = 0; i < length; i++)
            {
              c = client.read();
              line += c;
            }
            if (line.indexOf("do=ONOFF") >= 0)  //line에 do=ONOFF라는 글자가 있으면
            {
              State_Relay = !State_Relay;      //릴레이 상태변수 반전
              if (State_Relay == 1)            //릴레이 상태변수가 1이면 HIGH
              {
                setRelay(HIGH);
              }
              else                             //그렇지 않다면 Low
              {
                setRelay(LOW);
              }
            }
          }
          
          line = "";    //line 초기화

          CNT = false;  //CNT 초기화
          
          
          //클라이언트로 웹페이지를 출력
          
          client.println("HTTP/1.1 200 OK");      
          client.println("Content-Type: text/html");
          client.println("Connnection: close");
          client.println();
          client.println("<!DOCTYPE HTML>");
          client.println("<html>");

          // 브라우저 5초마다 새로고침
          client.println("<meta http-equiv='refresh' content='0'/>"); // 새로고침을 바로바로 수행
          client.println("<title>");
          client.print("HOME_IOT");   //페이지 제목
          client.println("</title>");
          client.println("<center>");
          client.println("<h1>");
          client.println("<b>");
          client.print("CAPSTONE_DESIGN");   //센터의 가장 큰 볼드체로 캡스톤디자인 출력
          client.println("</b>");
          client.println("</h1>");
          client.println("<h2>");
          client.print("IoT Smart Home");     //두번째로 큰 글씨로 IoT 스마트 홈 출력
          client.println("</h2>");

          // 온습도 센서 정보를 웹페이지 출력
          int h = dht.readHumidity();
          int t = dht.readTemperature();
          client.println("<h3>");
          client.print("Temperature : ");
          client.print(t);
          client.print("'C");
          client.println("<br>");       //줄띄움
          client.print("Humidity : ");
          client.print(h);
          client.print("%");
          client.println("<br />");     //줄띄움

          // 가스 감지 센서의 정보를 웹페이지 출력
          client.println("<br>");       //줄띄움
          client.println("Gas Sensor : ");
          if (GasVal == 1)              // 가스가 감지되지 않으면
          {
            client.println("No detecting.");
          }
          else if (GasVal == 0)
            // 가스가 감지되면
          {
            client.println("The gas is leaking!");
          }
          client.println("<br />");
          if (!Ethernet_Relay)
          {
            //릴레이 ON/OFF버튼생성
            client.println(("<input type=\"hidden\" name=\"do\" value=\"ONOFF\">"));
            client.println((" Relay Button <input type=\"button\" name=\"button1\" value=\"ON/OFF\" onclick=\"submit();\" >"));
            
          }
          client.println("</center>");
          client.println("</html>");
          break;
        }
          
        if (c == '\n')                     //클라이언트에게 공백을 받으면
        {
          Serial.print(line);              //시리얼모니터에 line값 출력
          currentLineIsBlank = true;       //현재 라인 값 true
          if (line.indexOf("Content-Length:") >= 0)  //line에 Content-Length:라는 글자가 있으면
          {
            String s = line.substring(line.indexOf(":") + 1);
            s.trim();
            length = s.toInt();

            CNT = true;
          }
          line = "";
        }

        else if (c != '\r')
        {
          currentLineIsBlank = false;
        }
      }
    }
    
    delay(1);         //브라우저 데이터 받는 시간
    client.stop();    //서버 연결 종료
    Serial.println("client disonnected");  //시리얼 모니터에 출력
  }
  //OLED에 CAPSTONE Detecting 출력
  OzOled.printString("--------------------", 0, 0);
  OzOled.printString("CAPSTONE", 3, 2);
  OzOled.printString("Detecting...", 2, 4);
  OzOled.printString("--------------------", 0, 6);

  //------------------------------------------------------

  if (GasVal == LOW)
    // 가스가 감지되면,
  {
    NewTone(Buzzerpin, 3951, 1500); // 부저 3951, 1.5초
    setColor(255, 120, 244); //자주색
    OzOled.drawBitmap(Gas_Leak, 0, 0, 16, 8); //OLED 가스감지 비트맵 출력
    OzOled.clearDisplay();  //OLED OFF
  }
  else
    // 가스가 감지되지 않으면
  {
    noNewTone(Buzzerpin); // 부저 OFF
    setColor(0, 0, 0); // RGB LED OFF
  }

  //------------------------------------------------------

  if (irrecv.decode(&results))       //9번핀에서 IR리시버의 값을 받아옴
  {
    if (results.value == 0xFF6897)   // 리모컨 버튼 0번을 눌렀을 때

    {
      State_Relay = ! State_Relay; //릴레이 상태변수 반전
      if (State_Relay == 1)        //릴레이 상태변수가 1이면 HIGH
      {
        setRelay(HIGH);
      }
      else                         //그렇지 않다면 Low
      {
        setRelay(LOW);
      }
    }
    irrecv.resume(); // 다음 값 받기
  }
  digitalWrite(Relaypin, State_Relay); // 변환된 상태 변수를 릴레이 모듈에 설정
}


void setColor(int red, int green, int blue)  // RGB LED 제어하는 함수
{
  analogWrite(redPin, red);        //red 아날로그 핀 쓰기
  analogWrite(greenPin, green);    //green 아날로그 핀 쓰기
  analogWrite(bluePin, blue);      //blue 아날로그 핀 쓰기
}

// 릴레이 모듈의 onoff. 부저와 RGB LED 제어
void setRelay(boolean RelayVal)
{
  if ( RelayVal == HIGH)    // 릴레이 모듈이 켜질 때
  {
    //OzOled.printString("PIR ON", 5, 0);
    NewTone(Buzzerpin, 261, 500);    //부저 261, 0.5초
    delay(100);
    
    NewTone(Buzzerpin, 392, 500);    //부저 392, 0.5초
    setColor(0, 0, 255);             //blue
    delay(100);
    
    setColor(255, 255, 0);           //yellow
    delay(100);
    
    setColor(255, 255, 255);         //white
    delay(100);
    
    setColor(0, 0, 0);               //RGB LED OFF
    OzOled.clearDisplay();           //OLED OFF
  }
  else
    // 릴레이 모듈이 꺼질 때
  {
    //OzOled.printString("PIR OFF", 4, 0);
    NewTone(Buzzerpin, 392, 500);    //부저 392, 0.5초 
    delay(100);
    
    NewTone(Buzzerpin, 261, 500);     //부저 261, 0.5초
    setColor(255, 0, 0);              //red
    delay(100);
    
    setColor(0, 255, 255);            //crimson
    delay(100);
    
    setColor(255, 255, 255);          //white
    delay(100);
    setColor(0, 0, 0);                //RGB LED OFF
    OzOled.clearDisplay();            //OLED oFF
  }
}
